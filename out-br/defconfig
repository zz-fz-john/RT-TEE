## out-br/defconfig
```kconfig
# Architecture
BR2_arm=y
BR2_cortex_a15=y
BR2_ARM_FPU_VFPV3D16=y
BR2_ARM_INSTRUCTIONS_THUMB2=y
BR2_CCACHE=y
BR2_TARGET_GENERIC_ISSUE="Welcome to Buildroot, type root or test to login"

BR2_TARGET_ROOTFS_CPIO=y
BR2_TARGET_ROOTFS_CPIO_GZIP=y
BR2_PACKAGE_HOST_E2FSPROGS=y
BR2_PACKAGE_OPTEE_CLIENT=y
BR2_TOOLCHAIN_EXTERNAL=y
BR2_TOOLCHAIN_EXTERNAL_CUSTOM=y
BR2_TOOLCHAIN_EXTERNAL_PATH="/home/zrz0517/study/TEE/RT-TEE/build/../toolchains/aarch32"
BR2_TOOLCHAIN_EXTERNAL_CUSTOM_PREFIX="arm-linux-gnueabihf"
BR2_TOOLCHAIN_EXTERNAL_GCC_8=y
BR2_TOOLCHAIN_EXTERNAL_HEADERS_4_18=y
BR2_TOOLCHAIN_EXTERNAL_CUSTOM_GLIBC=y
BR2_TOOLCHAIN_EXTERNAL_CXX=y

BR2_TARGET_GENERIC_GETTY_PORT="ttyS0"
BR2_ROOTFS_POST_BUILD_SCRIPT="board/raspberrypi3-64/post-build.sh"
BR2_PACKAGE_OPTEE_TEST_CROSS_COMPILE="/usr/bin/ccache /home/zrz0517/study/TEE/RT-TEE/build/../toolchains/aarch64/bin/aarch64-linux-gnu-"
BR2_PACKAGE_OPTEE_EXAMPLES_CROSS_COMPILE="/usr/bin/ccache /home/zrz0517/study/TEE/RT-TEE/build/../toolchains/aarch64/bin/aarch64-linux-gnu-"
BR2_PACKAGE_OPTEE_TEST_SDK="/home/zrz0517/study/TEE/RT-TEE/build/../optee_os/out/arm/export-ta_arm64"
BR2_PACKAGE_OPTEE_EXAMPLES_SDK="/home/zrz0517/study/TEE/RT-TEE/build/../optee_os/out/arm/export-ta_arm64"
BR2_PACKAGE_OPTEE_CLIENT_SITE="/home/zrz0517/study/TEE/RT-TEE/build/../optee_client"
BR2_PACKAGE_OPTEE_TEST_SITE="/home/zrz0517/study/TEE/RT-TEE/build/../optee_test"
BR2_PACKAGE_OPTEE_EXAMPLES_SITE="/home/zrz0517/study/TEE/RT-TEE/build/../optee_examples"
BR2_PACKAGE_OPTEE_BENCHMARK_SITE="/home/zrz0517/study/TEE/RT-TEE/build/../optee_benchmark"
BR2_PACKAGE_OPTEE_TEST=y
BR2_PACKAGE_OPTEE_EXAMPLES=y
BR2_PACKAGE_STRACE=y
BR2_PACKAGE_OPENSSL=y
BR2_PACKAGE_LIBOPENSSL=y
```
